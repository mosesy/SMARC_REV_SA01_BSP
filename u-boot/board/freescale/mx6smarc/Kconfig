## u-boot/board/freescale/mx6smarc/Kconfig
```kconfig
if TARGET_MX6SMARC

config SYS_BOARD
	default "mx6smarc"

config SYS_VENDOR
	default "freescale"

config SYS_SOC
	default "mx6"

config SYS_CONFIG_NAME
	default "mx6smarc"

endif
```

## u-boot/configs/mx6dlsmarc_defconfig
```kconfig
CONFIG_SYS_EXTRA_OPTIONS="IMX_CONFIG=board/freescale/mx6smarc/mx6dl_micron_1g.cfg,MX6DL,SYS_USE_SPINOR"
CONFIG_ARM=y
CONFIG_TARGET_MX6SMARC=y
CONFIG_DM=y
CONFIG_DM_THERMAL=y
```

## u-boot/configs/mx6dsmarc_pfuze100_1g_e14s6102g51h_defconfig
```kconfig
CONFIG_SYS_EXTRA_OPTIONS="IMX_CONFIG=board/freescale/mx6smarc/mx6d_micron_1g_e14s6102g51h.cfg,MX6Q,SYS_USE_SPINOR,SMARC_PFUZE100"
CONFIG_ARM=y
CONFIG_TARGET_MX6SMARC=y
CONFIG_DM=y
CONFIG_DM_THERMAL=y
```

## u-boot/configs/mx6qsmarc_pfuze100_2g_e14s6104g52h_defconfig
```kconfig
CONFIG_SYS_EXTRA_OPTIONS="IMX_CONFIG=board/freescale/mx6smarc/mx6q_micron_2g_e14s6104g52h.cfg,MX6Q,SYS_USE_SPINOR,SMARC_PCIE_PFUZE100_2G"
CONFIG_ARM=y
CONFIG_TARGET_MX6SMARC=y
CONFIG_DM=y
CONFIG_DM_THERMAL=y
```

## u-boot/configs/mx6qsmarc_wm8326_2g_defconfig
```kconfig
CONFIG_SYS_EXTRA_OPTIONS="IMX_CONFIG=board/freescale/mx6smarc/mx6q_micron_2g.cfg,MX6Q,SYS_USE_SPINOR,SMARC_PCIE_WM8326_2G"
CONFIG_ARM=y
CONFIG_TARGET_MX6SMARC=y
CONFIG_DM=y
CONFIG_DM_THERMAL=y
```

## u-boot/configs/mx6qsmarc_wm8326_defconfig
```kconfig
CONFIG_SYS_EXTRA_OPTIONS="IMX_CONFIG=board/freescale/mx6smarc/mx6q_micron_1g.cfg,MX6Q,SYS_USE_SPINOR,SMARC_WM8326"
CONFIG_ARM=y
CONFIG_TARGET_MX6SMARC=y
CONFIG_DM=y
CONFIG_DM_THERMAL=y
```

## u-boot/configs/mx6solosmarc_pfuze100_defconfig
```kconfig
CONFIG_SYS_EXTRA_OPTIONS="IMX_CONFIG=board/freescale/mx6smarc/mx6solo_micron_1g.cfg,MX6DL,SYS_USE_SPINOR,SMARC_PCIE_PFUZE100"
CONFIG_ARM=y
CONFIG_TARGET_MX6SMARC=y
CONFIG_DM=y
CONFIG_DM_THERMAL=y
```
